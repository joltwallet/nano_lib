## Kconfig
```kconfig
menu "Nano ESP32 Library Config"

    config NANO_LIB_ENABLE
        bool
        prompt "Enable the Nano Library"
        default y
        help
            Enable nano_lib library (toggle not implemented)

    config NANO_LIB_POW_UNIT_TEST_IGNORE
        bool
        prompt "Ignore the PoW Unit Test (long run time)"
        default y
        help
            Disable the PoW Unit Test when running all unit tests

    config NANO_LIB_ADDRESS_PREFIX
        string
        prompt "prefix to apply for address data"
        depends on NANO_LIB_ENABLE
        default "xrb_"
        help
            Typically "xrb_" or "nano_"

    config NANO_LIB_DERIVATION_PATH
        int
        prompt "Nano's BIP derivation index"
        depends on NANO_LIB_ENABLE
        default 165
        help
            BIP39/44 index to use

    config NANO_LIB_CUSTOM_HASH
        bool
        prompt "Use custom blake2b implementation."
        default n
        help
            Copy nano_lib_hash.h into the parent directory and populate.
            

    config NANO_LIB_SIGNATURE_INTERNAL
        bool
        prompt "Use standalone signature code"
        default y
        help
            Use an internal implementation of ed25519 rather than depending on
            libsodium internals.

endmenu
```
